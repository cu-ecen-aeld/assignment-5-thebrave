## base_external/Config.in
```kconfig
# Config.in

# Include the Config.in for your specific custom packages here.
# Notice how we use the dynamically generated path variable based 
# on the name defined in external.desc.
source "$BR2_EXTERNAL_AESD_PROJECT_PATH/package/aesd-assignments/Config.in"
```

## base_external/package/ldd/Config.in
```kconfig
config BR2_PACKAGE_LDD
	bool "ldd"
	help
	  Includes the ldd and scull kernel modules for the assignment 7 onwards
```
